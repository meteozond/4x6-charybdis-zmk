## config/west.yml
```yaml
manifest:
  remotes:
    - name: zmkfirmware
      url-base: https://github.com/zmkfirmware
    - name: petejohanson
      url-base: https://github.com/petejohanson
    - name: inorichi
      url-base: https://github.com/inorichi
    - name: meteozond
      url-base: https://github.com/meteozond
    - name: Luberry
      url-base: https://github.com/Luberry
  projects:
#    - name: zmk
#      remote: zmkfirmware
#      revision: main
#      import: app/west.yml
#    - name: zmk
#      remote: petejohanson
#      revision: feat/pointers-move-scroll
#      import: app/west.yml

    - name: zmk
      remote: Luberry
      revision: pmw3389
      import: app/west.yml
    - name: zmk-pmw3610-driver
      remote: inorichi
      revision: main
  self:
    path: config
```
